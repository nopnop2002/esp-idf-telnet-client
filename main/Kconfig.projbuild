## main/Kconfig.projbuild
```kconfig
menu "Application Configuration"

	config ESP_WIFI_SSID
		string "WiFi SSID"
		default "myssid"
		help
			SSID (network name) to connect to.

	config ESP_WIFI_PASSWORD
		string "WiFi Password"
		default "mypassword"
		help
			WiFi password (WPA or WPA2) to connect to.

	config ESP_MAXIMUM_RETRY
		int "Maximum retry"
		default 5
		help
			Set the Maximum retry to avoid station reconnecting to the AP unlimited when the AP is really inexistent.

	config TELNET_SERVER
		string "Telnet Server IP or mDNS"
		default "TelnetServer.local"
		help
			Telnet Server host name or ip address.

	config TELNET_PORT
		int "Telnet Server Port"
		default 23
		help
			Telnet Server ports.

	config TELNET_USER
		string "Telnet Login User"
		default "myTelnetUer"
		help
			Telnet Login User name.

	config TELNET_PASSWORD
		string "Telnet Login Password"
		default "myTelnetPass"
		help
			Telnet Login Password.

endmenu
```
